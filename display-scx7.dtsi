// SPDX-License-Identifier: GPL-2.0-or-later OR MIT
/*
 * Copyright © 2024 TecInvent
 * Author: Kevin Detta <kevin.detta@tecinvent.ch>
 * Author: Dina Gomes Dias <dina.gomes@tecinvent.ch>
 */

// SCX 7inch LVDS Display Dimensions and Timing

&panel_dpi {
	status = "okay";

	width-mm = <154>;
	height-mm = <86>;

	panel-timing {
		/* Official OPTO logic frequency is 51200000, but linux-nxp only supports specific modes.
		 * See: https://developer.toradex.com/linux-bsp/application-development/multimedia/display-output-resolution-and-timings-linux/#verdin-imx8m-plus-lvds-known-issues */
		clock-frequency = <74250000>;
		hactive = <1024>;
		hback-porch = <150>;
		hfront-porch = <150>;
		hsync-len = <20>;
		vactive = <600>;
		vback-porch = <15>;
		vfront-porch = <15>;
		vsync-len = <5>;

		de-active = <1>;
		hsync-active = <0>;
		vsync-active = <0>;
		pixelclk-active = <0>;
	};
};
