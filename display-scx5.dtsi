// SPDX-License-Identifier: GPL-2.0-or-later OR MIT
/*
 * Copyright © 2024 TecInvent
 * Author: Kevin Detta <kevin.detta@tecinvent.ch>
 * Author: Dina Gomes Dias <dina.gomes@tecinvent.ch>
 */

// SCX 5inch LVDS Display Dimensions and Timing

&panel_dpi {
	status = "okay";

	width-mm = <108>;
	height-mm = <65>;

	panel-timing {
		clock-frequency = <25000000>;
		hactive = <800>;
		hback-porch = <8>;
		hfront-porch = <8>;
		hsync-len = <4>;
		vactive = <480>;
		vback-porch = <8>;
		vfront-porch = <8>;
		vsync-len = <4>;

		de-active = <1>;
		hsync-active = <0>;
		vsync-active = <0>;
		pixelclk-active = <0>;
	};
};
