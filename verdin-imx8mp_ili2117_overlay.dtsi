// SPDX-License-Identifier: GPL-2.0-or-later OR MIT
/*
 * Copyright © 2024 TecInvent
 * Author: Kevin Detta <kevin.detta@tecinvent.ch>
 * Author: Dina Gomes Dias <dina.gomes@tecinvent.ch>
*/

&i2c2{
	status = "okay";
	#address-cells = <2>;
	#size-cells = <1>;
	clock-frequency = <100000>;
	touch@26 {
		compatible = "ilitek,ili2117";
		reg = <0x26>;
		pinctrl-names = "default";
		interrupt-parent = <&gpio4>;
		interrupts = <31 IRQ_TYPE_EDGE_RISING>;
		reset-gpios = <&gpio4 30 GPIO_ACTIVE_LOW>;
        status = "okay";
	};
};

